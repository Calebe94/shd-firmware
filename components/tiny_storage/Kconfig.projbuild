## components/tiny_storage/Kconfig.projbuild
```kconfig
menu "T2I Storage Driver"
    
    config USE_SDCARD
        int "Use SD Card Module"
        range 0 1
        default 0
        help
            Set the SD Card module to be used

    config SD_MISO
        int "SD Card SPI MISO GPIO"
        range 0 33
        default 23
        help
            Set the GPIO number used by SPI MISO.

    config SD_MOSI
        int "SD Card SPI MOSI GPIO"
        range 0 33
        default 23
        help
            Set the GPIO number used by SPI MOSI.

    config SD_SCK
        int "SD Card SPI SCK GPIO"
        range 0 33
        default 23
        help
            Set the GPIO number used by SPI SCK.

    config SD_CS
        int "SD CardSPI CS GPIO number"
        range 0 33
        default 22
        help
            Set the GPIO number used by SPI CS.
    
endmenu
```

## components/tiny_webservice/Kconfig.projbuild
```kconfig
menu "ESP Webservice Configuration"
    config USE_MDNS
        int "Use mDNS module"
        range 0 1
        default 0
        help
            Set mDNS module to be used.

    config USE_WEBSERVICE
        int "Use Webservice module"
        range 0 1
        default 0
        help
            Set Webservice module to be used.

    config MDNS_HOST_NAME
        string "mDNS Host Name"
        default "esp-home"
        help
            Specify the domain name used in the mDNS service.
            Note that webpage also take it as a part of URL where it will send GET/POST requests to.

endmenu
```

## components/tiny_wifi/Kconfig.projbuild
```kconfig
menu "Wifi Configuration"
    config USE_WIFI
        int "Use wifi module"
        range 0 1
        default 0
        help
            Set wifi module to be used.

    config WIFI_MODE
        int "Select wifi mode between STA, AP or both"
        range 0 2
        default 2
        help
            Select wifi mode between STA, AP or both

    config WIFI_STA_SSID
        string "WiFi STA SSID"
        default "myssid"
        help
            WiFi SSID STA (network name) to connect to.

    config WIFI_STA_PASS
        string "WiFi STA Password"
        default "mypassword"
        help
            WiFi STA password (WPA or WPA2) to use.
            Can be left blank if the network has no security set.

    config WIFI_AP_SSID
        string "WiFi AP SSID"
        default "myssid"
        help
            WiFi SSID AP (network name) to connect to.

    config WIFI_AP_PASS
        string "WiFi AP Password"
        default "mypassword"
        help
            WiFi AP password (WPA or WPA2) to use.
            Can be left blank if the network has no security set.
    
    config WIFI_AP_MAX_STA_CONN
        int "WiFi Access Point Max connections allowed"
        default 1
        help
            Max number of the STA connections to AP.        

endmenu
```

## sdkconfig.defaults
```kconfig
CONFIG_HTTPD_MAX_REQ_HDR_LEN=1024
#CONFIG_SPIFFS_OBJ_NAME_LEN=64
CONFIG_FATFS_LONG_FILENAME=y
CONFIG_FATFS_LFN_HEAP=y

#
# Partition Table
#
CONFIG_ESPTOOLPY_FLASHSIZE_4MB=y
CONFIG_PARTITION_TABLE_CUSTOM=y
CONFIG_PARTITION_TABLE_CUSTOM_FILENAME="partitions.csv"
CONFIG_PARTITION_TABLE_FILENAME="partitions.csv"
CONFIG_LWIP_TCPIP_TASK_STACK_SIZE=8192
CONFIG_ESP_MAIN_TASK_STACK_SIZE=8192
#CONFIG_SPIFFS_META_LENGTH=0

#
# ESP Webservice Configuration
#
CONFIG_USE_MDNS=0
CONFIG_USE_WEBSERVICE=0
CONFIG_MDNS_HOST_NAME="hidrometro-digital"
# end of ESP Webservice Configuration

#
# Wifi Configuration
#
CONFIG_USE_WIFI=0
CONFIG_WIFI_MODE=1
CONFIG_WIFI_STA_SSID="myssid"
CONFIG_WIFI_STA_PASS="mypassword"
CONFIG_WIFI_AP_SSID="hidrometro_digital"
CONFIG_WIFI_AP_PASS="hidrometro"
CONFIG_WIFI_AP_MAX_STA_CONN=1

# Override some defaults to enable Arduino framework
CONFIG_ENABLE_ARDUINO_DEPENDS=y
CONFIG_AUTOSTART_ARDUINO=y
CONFIG_ARDUINO_RUN_CORE1=y
CONFIG_ARDUINO_RUNNING_CORE=1
CONFIG_ARDUINO_EVENT_RUN_CORE1=y
CONFIG_ARDUINO_EVENT_RUNNING_CORE=1
CONFIG_ARDUINO_UDP_RUN_CORE1=y
CONFIG_ARDUINO_UDP_RUNNING_CORE=1
CONFIG_DISABLE_HAL_LOCKS=y
CONFIG_ARDUHAL_LOG_DEFAULT_LEVEL_ERROR=y
CONFIG_ARDUHAL_LOG_DEFAULT_LEVEL=1
CONFIG_ARDUHAL_PARTITION_SCHEME_DEFAULT=y
CONFIG_ARDUHAL_PARTITION_SCHEME="default"
CONFIG_AUTOCONNECT_WIFI=y
CONFIG_ARDUINO_SELECTIVE_WiFi=y
CONFIG_MBEDTLS_PSK_MODES=y
CONFIG_MBEDTLS_KEY_EXCHANGE_PSK=y
# Example configs
CONFIG_EXAMPLE_WIFI_SSID="MYSSID"
CONFIG_EXAMPLE_WIFI_PASSWORD="MYPASS"
```
